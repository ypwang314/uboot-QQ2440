## board/samsung/QQ2440/Kconfig
```kconfig
if TARGET_QQ2440

config SYS_BOARD
	default "QQ2440"

config SYS_VENDOR
	default "samsung"

config SYS_SOC
	default "s3c24x0"

config SYS_CONFIG_NAME
	default "QQ2440"

endif
```

## configs/QQ2440_defconfig
```kconfig
CONFIG_ARM=y
CONFIG_TARGET_QQ2440=y
CONFIG_HUSH_PARSER=y
CONFIG_SYS_PROMPT="QQ2440 # "
CONFIG_CMD_USB=y
# CONFIG_CMD_SETEXPR is not set
CONFIG_CMD_DHCP=y
CONFIG_CMD_PING=y
CONFIG_CMD_CACHE=y
CONFIG_CMD_EXT2=y
CONFIG_CMD_FAT=y
CONFIG_CMD_UBI=y
CONFIG_USB=y
CONFIG_USB_STORAGE=y
CONFIG_USB_KEYBOARD=y
#Add 20170830
CONFIG_NAND_QQ2440=y
```
